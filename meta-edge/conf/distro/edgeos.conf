## meta-edge/conf/layer.conf
```bitbake
# meta-edge — EdgeOS custom Yocto layer
BBPATH .= ":${LAYERDIR}"

BBFILES += "${LAYERDIR}/recipes-*/*/*.bb \
             ${LAYERDIR}/recipes-*/*/*.bbappend"

BBFILE_COLLECTIONS += "edge"
BBFILE_PATTERN_edge = "^${LAYERDIR}/"
BBFILE_PRIORITY_edge = "10"

LAYERSERIES_COMPAT_edge = "wrynose"
LAYERVERSION_edge = "1"
```
